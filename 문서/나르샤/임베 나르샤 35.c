//shift_out(data, clk, MSBFIRST, 0xff);
// LCD_CS PA3
// LCD_SCK PA1
//LCD_MOSI PC1
void setup()
{
	DDRA |= 0x0A;
	DDRC |= 0x02;

	PORTA = 0x00;
	PORTC = 0x00;
//---------------------

	lcd_set_inst(0x30);
	lcd_set_inst(0x30);
	lcd_set_inst(0x30);

	lcd_set_inst(0x30); // clear
	lcd_set_inst(0x06);	
	lcd_set_inst(0x0c);

	lcd_set_inst(0x01);
	delay(10);
	lcd_cls();
	delay(1000);
}

short num_2[8] = {0x00, 0x38, 0x44, 0x04, 0x08, 0x10, 0x20, 0x7c};

unsigned char num[10][8] = {
  {0x00, 0x38, 0x44, 0x4C, 0x54, 0x64, 0x44, 0x38},
  {0x00, 0x10, 0x30, 0x50, 0x10, 0x10, 0x10, 0x7c},
  {0x00, 0x38, 0x44, 0x04, 0x08, 0x10, 0x20, 0x7c},
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  {0x00, 0x38, 0x44, 0x44, 0x3C, 0x04, 0x44, 0x38},
};

void loop() // 프린터 lcd 출력들
{
	for(int j = 0; j < 10; j++)
	{
		for(int i = 0; i < 8; i++)
		{
			set_data(1,i+7, num[j][i]);
		}
		delay(1000);
	}
	
}

void lcd_cls()
{
	for(int j = 0; j < 32; j++)
	{
		for(int i = 0; i < 16; i++)
		{
			set_data(i,j,0x0000);
		}
	}
}

void set_data(int x, int y, short data)
{
	char addr_x = 0x80 | (x & 0x0f);
	char addr_y = 0x80 | (y & 0x7f);
	char data_high = (data & 0xff00) >> 8;
	char data_low = data & 0x00ff;

	lcd_set_inst(0x36);
	lcd_set_inst(addr_y);
	lcd_set_inst(addr_x);

	lcd_set_inst(0x30);
	lcd_set_data(data_high);
	lcd_set_data(data_low);

}

void lcd_set_inst(char inst)
{
	PORTA |= 0x08; // cs high

	shift_out(0xf8);
	shift_out(inst & 0xf0);
	shift_out((inst & 0x0f) << 4);

	PORTA &= ~0x08; // cs low
	delayMicroseconds(50);
}

void lcd_set_data(char data)
{
	PORTA |= 0x08; // cs high

	shift_out(0xfa);
	shift_out(data & 0xf0);
	shift_out((data & 0x0f) << 4);

	PORTA &= ~0x08; // cs low
	delayMicroseconds(50);
}

void shift_out(char data)
{
	for(int i = 0; i < 8; i++)
	{
		if(data & (0x80 >> i))
		{
			PORTC |= 0x02; // data high
		}
		else
		{
			PORTC &= ~0x02; // data low
		}

		PORTA |= 0x02;
		PORTA &= ~0x02;
	}
}