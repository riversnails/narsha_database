#define X_DIR 0x20		// PC5
#define X_STEP 0x80	    // PD7
#define X_STOP 0x04		// PC2
#define XYEENABLE 0x40  // PD6
#define	Y_DIR 0x80	//PC7
#define	Y_STEP 0x40	//PC6
#define	Y_STOP 0x08	//PC3
#define ONE_mm 80	//1mm
#define ONE_cm 800	//1cm
#define X_LEFT PORTC | X_DIR
#define X_RIGHT PORTC & ~(X_DIR)
#define Y_UP PORTC | Y_DIR
#define Y_DOWN PORTC & ~(Y_DIR)
enum{	//상수 리스트(왼쪽부터 0, 1, 2, 3 ... 으로 초기화)
	x_left, x_right, y_up, y_down
};
//각도를 라디안으로 만들어줌
double ANGLE(int x) {
	return PI * (x / 180.0);
}
//volatile : 컴파일러가 자동으로 최적하 하지 않도록 함.
volatile char is_x_reset = 1;
int x_distance = 0;
volatile char is_y_reset = 1;
int y_distance = 0;
double current_x = 0;	//mm 단위
double current_y = 0;	//mm 단위
//속도는 기본 400으로 한다.
void x_move(int x_dis, int DIR, int x_speed) {
	//------DIR change------
	if (DIR == x_left) PORTC = X_LEFT;
	if (DIR == x_right) PORTC = X_RIGHT;
	//------Distance change------
	x_distance = x_dis;
	//------Speed------
	TIMSK1 = 0x00;
	OCR1A = x_speed;
	//------Enable Timer X------
	TIMSK1 = 0x02;
}
void y_move(int y_dis, int DIR, int y_speed) {
	//------DIR change------
	if (DIR == y_up) PORTC = Y_UP;
	if (DIR == y_down) PORTC = Y_DOWN;
	//------Distance change------
	y_distance = y_dis;
	//------Speed------
	TIMSK3 = 0x00;
	OCR3A = y_speed;
	//------Enable Timer X------
	TIMSK3 = 0x02;
}
void reset() {
	is_x_reset = 1;
	is_y_reset = 1;
	x_move(32000, x_left, 400);
	y_move(32000, y_up, 400);
	while (is_x_reset != 0 || is_y_reset != 0);
	current_x = 0;
	current_y = 0;
}
void goXLocation(double x, int x_speed) {
	int dir = x_right;
	if (current_x > x) dir = x_left;
	x_move(abs(current_x - x) * ONE_mm, dir, x_speed);	//※abs : 절대값
	current_x = x;
}
void goYLocation(double y, int y_speed) {
	int dir = y_down;
	if (current_y > y) dir = y_up;
	y_move(abs(current_y - y) * ONE_mm, dir, y_speed);	//※abs : 절대값
	current_y = y;
}
void coordinate_shift(double x, double y) {
	//기본 속도 (400)
	int x_speed = 400;
	int y_speed = 400;
	double dis_X = 0;	// X거리
	double dis_Y = 0;	// Y거리
	int dir_X = x_right;  // X 방향
	int dir_Y = y_down;   // Y 방향

	if (current_x > x) dir_X = x_left;
	if (current_y > y) dir_Y = y_up;

	dis_X = abs(current_x - x);
	dis_Y = abs(current_y - y);

	Serial.print("dis:");
	Serial.print(dis_X);
	Serial.print(" ");
	Serial.println(dis_Y);

	Serial.print("xy:");
	Serial.print(x);
	Serial.print(" ");
	Serial.println(y);

	if (dis_X > dis_Y) {
		y_speed = (int)(400 * (dis_X / dis_Y));
	}
	else {
		x_speed = (int)(400 * (dis_Y / dis_X));
	}
	x_move(dis_X * ONE_mm, dir_X, x_speed);
	y_move(dis_Y * ONE_mm, dir_Y, y_speed);
	current_x = x;
	current_y = y;
	while (TIMSK1 != 0X00 || TIMSK3 != 0X00);
}
int set_speed(double x, double y) {
	int speed = 0;
	if (x > y) {
		speed = (int)(400.0 * (y / x));
	}
	else {
		speed = (int)(400.0 * (x / y));
	}
	return speed;
}
//대각선 이동할때, X축이 움직일 거리
double X_move_distance(double dis, int dir, int angle) {	//대각선의 이동거리와 삼각비의 기준이 될 각도를 매개변수로 받음
	double x_move_dis = 0;
	if (dir == x_right) x_move_dis = current_x + (dis * cos(ANGLE(angle)));
	if (dir == x_left) x_move_dis = current_x - (dis * cos(ANGLE(angle)));
	return x_move_dis;
}
// 대각선 이동할때, Y축이 움직일 거리
double Y_move_distance(int dis, int dir,int angle) {	//대각선의 이동거리와 삼각비의 기준이 될 각도를 매개변수로 받음
	double y_move_dis = 0;
	if (dir == y_down) y_move_dis = current_y + (dis * sin(ANGLE(angle)));
	if (dir == y_up) y_move_dis = current_y - (dis * sin(ANGLE(angle)));
	return y_move_dis;
}
//치약짜개 배열
const float xy_pos[480][2] = {
66.268 , 82.377,
66.527 , 82.217,
66.796 , 82.073,
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93.764 , 101.139
};
void setup(){
	DDRC |= X_DIR;	//RIGHT DIRECTION
	DDRD |= X_STEP | XYEENABLE;
	DDRC &= ~(X_STOP);
	DDRC |= (Y_DIR | Y_STEP);
	DDRC &= ~(Y_STOP);
	//X Location
	TCCR1A = 0x00;
	TCCR1B = 0x0A;
	TCCR1C = 0x00;
	OCR1A = 400;
	TIMSK1 = 0x00;
	//Y Location
	TCCR3A = 0x00;
	TCCR3B = 0x0A;
	TCCR3C = 0x00;
	OCR3A = 400;
	TIMSK3 = 0x00;
	Serial.begin(9600);
	reset();
	//reset();
	//좌표 이동(이등변 삼각형) (처음 좌표 설정)
	/*
	goXLocation(10, 400);
	goYLocation(10, 400);
	while (TIMSK1 != 0X00 || TIMSK3 != 0X00);
	*/
	//육각형 좌표 이동 (처음 좌표 설정)
	/*
	goXLocation(50, 400);
	goYLocation(10, 400);
	while (TIMSK1 != 0X00 || TIMSK3 != 0X00);
	*/
	//육각형 시작점 (50, 10)을 기본 좌표로 설정
	//coordinate_shift(50, 10);
}
//char x_step_dir = 0;
//char y_step_dir = 0;
void loop() {
	//사각형 그리기(방향전환)
	/*
	// X축 Direction
	TIMSK1 = 0x02;
	while (TIMSK1 != 0x00);
	if (x_step_dir == 0) {
		x_step_dir = 1;
		PORTC |= X_DIR;
	}
	else {
		x_step_dir = 0;
		PORTC &= ~(X_DIR);
	}
	// Y축 Direction
	TIMSK3 = 0x02;
	while (TIMSK3 != 0x00);
	if (y_step_dir == 0) {
		y_step_dir = 1;
		PORTC |= Y_DIR;
	}
	else {
		y_step_dir = 0;
		PORTC &= ~(Y_DIR);
	}
	*/
	//직삼각형 (밑변(x) : 50mm , 높이(y) : 25mm)
	/*
	x_move(4000, x_right, 400);
	while (TIMSK1 != 0X00);
	y_move(2000, y_down, 400);
	while (TIMSK3 != 0X00);
	x_move(4000, x_left, 200);
	y_move(2000, y_up, 400);
	while (TIMSK1 != 0X00 || TIMSK3 != 0X00);
	*/
	//좌표로 이동 
	/*
	//(10, 50) 이동
	goYLocation(50, 400);
	while (TIMSK3 != 0X00);
	//(40, 30) 이동
	goXLocation(40, set_speed(30, 20));
	goYLocation(30, 400);
	while (TIMSK1 != 0X00 || TIMSK3 != 0X00);
	//(10, 10) 이동
	goXLocation(10, set_speed(30, 20));
	goYLocation(10, 400);
	while (TIMSK1 != 0X00 || TIMSK3 != 0X00);
	*/
	//좌표 (함수로 축약)
	/*
	coordinate_shift(10, 50);
	coordinate_shift(40, 30);
	coordinate_shift(10, 10);
	*/
	//육각형 좌표 이동(한변의 길이 : 30mm)
	/*
	coordinate_shift(80, 10);
	coordinate_shift(80 + (30 * cos(ANGLE(60))),10 + (30 * sin(ANGLE(60))));
	coordinate_shift(80, (10 + 2 * (30 * sin(ANGLE(60)))));
	coordinate_shift(50, (10 + 2 * (30 * sin(ANGLE(60)))));
	coordinate_shift(50 - (30 * cos(ANGLE(60))), (10 + (30 * sin(ANGLE(60)))));
	coordinate_shift(50, 10);
	*/
	//육각형 좌표이동 (한변의 길이 : 30mm) - 함수로 축약
	/*
	coordinate_shift(80, 10);
	coordinate_shift(X_move_distance(30, x_right, 60), Y_move_distance(30, y_down, 60));
	coordinate_shift(80, Y_move_distance(30, y_down, 60));
	coordinate_shift(50, current_y);
	coordinate_shift(X_move_distance(30, x_left, 60), Y_move_distance(30, y_up, 60));
	coordinate_shift(50, 10);
	*/
	//치약 짜개 (배열)
	for (int i = 0; i < 480; i++) {
		coordinate_shift(xy_pos[i][0], xy_pos[i][1]);
		Serial.println(i);
	}
}
char x_step_toggle = 0;
volatile int x_step_count = 0;
ISR(TIMER1_COMPA_vect) {	//X축만 관여함  / 인터럽트 발생할 때마다 스텝을 껏다켰다 반복
	if (x_step_toggle == 0) {
		x_step_toggle = 1;
		PORTD |= X_STEP;
	}
	else {
		x_step_toggle = 0;
		PORTD &= ~(X_STEP);
		x_step_count++;
		char x_limit_switch = PINC & X_STOP;
		//5cm 이동
		/*
		if (x_step_count >= (5 * ONE_cm)) {	//X축 5cm 이동
			x_step_count = 0;
			TIMSK1 = 0x00;	//멈춤
		}
		//리밋 스위치를 누르면 동작 멈춤
		if (x_limit_switch) {	//X축 리밋 스위치를 눌렀을 때
			TIMSK1 = 0x00;
		}
		*/
		if (x_step_count >= x_distance) {
			is_x_reset = 0;
			x_step_count = 0;
			TIMSK1 = 0x00;
		}
		if (x_limit_switch && is_x_reset != -1) {
			TIMSK1 = 0x00;
			x_step_count = 0;
			if (is_x_reset == 1) {
				is_x_reset = -1;
				x_move(ONE_cm * 5, x_right, 400);
			}
		}
	}
}
char y_step_toggle = 0;
volatile int y_step_count = 0;
ISR(TIMER3_COMPA_vect) {	//Y축만 관여함  / 인터럽트 발생할 때마다 스텝을 껏다켰다 반복
	if (y_step_toggle == 0) {
		y_step_toggle = 1;
		PORTC |= Y_STEP;
	}
	else {
		y_step_toggle = 0;
		PORTC &= ~(Y_STEP);
		y_step_count++;
		char y_limit_switch = PINC & Y_STOP;
		//5cm 이동
		/*
		if (y_step_count >= (5 * ONE_cm)) {	//Y축 5cm 이동
			y_step_count = 0;
			TIMSK3 = 0x00;
		}
		//리밋 스위치를 누르면 동작 멈춤
		if (y_limit_switch) {	//Y축 리밋 스위치를 눌렀을때
			TIMSK3 = 0x00;
		}
		*/
		if (y_step_count >= y_distance) {
			is_y_reset = 0;
			y_step_count = 0;
			TIMSK3 = 0x00;
		}
		if (y_limit_switch && is_y_reset != -1) {
			TIMSK3 = 0x00;
			y_step_count = 0;
			if (is_y_reset == 1) {
				is_y_reset = -1;
				y_move(ONE_cm * 5, y_down, 400);
			}
		}
	}
}